## firmware/main/Kconfig.projbuild
```kconfig
menu "Xiaozhi Assistant"

config USE_EMOTE_MESSAGE_STYLE
    bool "Use rawdraw 1bpp rendering (no LVGL)"
    default y
    help
        When enabled, the display uses rawdraw 1bpp framebuffer rendering
        instead of LVGL. This is the recommended mode for the ZecTrix
        S3 E-Paper 4.2 board as LVGL causes frequent crashes.

config BOARD_TYPE_ZECTRIX_S3_EPAPER_4_2
    bool "zectrix-s3-epaper-4.2 FT firmware"
    default y
    depends on IDF_TARGET_ESP32S3
    help
        This local repository has been reduced to a single FT-only firmware
        for the zectrix-s3-epaper-4.2 board.

choice ZECTRIX_EPD_PANEL_TYPE
    prompt "ZecTrix EPD panel type"
    default ZECTRIX_EPD_PANEL_4COLOR_SSD2683
    depends on BOARD_TYPE_ZECTRIX_S3_EPAPER_4_2
    help
        Select the e-paper panel connected to the board. The 4-color option
        keeps the existing 1bpp UI framebuffer and converts it to the SSD2683
        2bpp wire format during refresh.

config ZECTRIX_EPD_PANEL_1BPP
    bool "1bpp black/white EPD"

config ZECTRIX_EPD_PANEL_4COLOR_SSD2683
    bool "4-color BWRY SSD2683 EPD"

endchoice

config ZECTRIX_EPD_4COLOR_BOOT_TEST_PATTERN
    bool "Show 4-color EPD test pattern at boot"
    default n
    depends on ZECTRIX_EPD_PANEL_4COLOR_SSD2683
    help
        Show black/white/red/yellow vertical bars once during display
        initialization so a newly connected 4-color panel can be verified.

menu "Weather & holiday data"
    depends on BOARD_TYPE_ZECTRIX_S3_EPAPER_4_2

config QWEATHER_API_KEY
    string "QWeather (HeWeather) API key"
    default ""
    help
        和风天气 API Key。留空则天气页无数据,启动时会打 WARNING 日志。
        去 https://dev.qweather.com 注册免费 Key(免费版每天 1000 次足够,
        设备每小时刷新一次约 72 次/天)。Key 会编译进固件。

config QWEATHER_DEFAULT_CITY
    string "QWeather default city LocationID"
    default "101210100"
    help
        默认城市 LocationID。例如 101210100=杭州,101010100=北京。
        完整列表见 https://github.com/qwd/LocationList。

config HOLIDAY_FETCH_ENABLED
    bool "Fetch official Chinese holidays for calendar"
    default y
    help
        启用后,日历页会在 WiFi 连接时自动从 timor.tech 抓取国务院节假日
        数据并缓存到 NVS,标注"休"/"班"。该 API 免费公开,无需 Key。
endmenu

endmenu
```
